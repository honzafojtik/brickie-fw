## boards/shields/brickie/Kconfig.defconfig
```kconfig
if SHIELD_BRICKIE_LEFT

config ZMK_KEYBOARD_NAME
    default "brickie"

config ZMK_SPLIT_ROLE_CENTRAL
    default y

endif # SHIELD_BRICKIE_LEFT

if SHIELD_BRICKIE_LEFT || SHIELD_BRICKIE_RIGHT

config ZMK_SPLIT
    default y

endif # SHIELD_BRICKIE_LEFT || SHIELD_BRICKIE_RIGHT
```

## boards/shields/brickie/Kconfig.shield
```kconfig
config SHIELD_BRICKIE_LEFT
    def_bool $(shields_list_contains,brickie_left)

config SHIELD_BRICKIE_RIGHT
    def_bool $(shields_list_contains,brickie_right)
```
